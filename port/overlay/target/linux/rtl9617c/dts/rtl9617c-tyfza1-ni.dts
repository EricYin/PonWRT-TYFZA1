// SPDX-License-Identifier: GPL-2.0-only
#include "rtl9617c-tyfza1-dma-tx.dts"
#include <dt-bindings/gpio/gpio.h>
#include "rtl9617c-tyfza1-leds.dtsi"

/ { model = "Tianyi TYFZA1 (native NI/DMA bring-up)"; };

&{/soc/ethernet@4f4300000} {
	reg = <4 0xf4300000 0 0x10000>, <0 0xf4500000 0 0x2000>,
	      <4 0xf7001000 0 0x1000>, <4 0xf432d000 0 0x1000>,
	      <4 0xf4320098 0 4>, <4 0xf432f000 0 0x1000>;
	reg-names = "ni", "xram", "dma-lso", "qm-axi-reorder", "block-reset",
		    "l3fe-axi-reorder";
	realtek,qm-rx;
	/* Do NOT reverse realtek,lan-phys or phy-handle here.
	 *
	 * A MAC port and its PHY are wired together on the board: port 0 can only
	 * talk to phy0 (mdio:01), port 3 only to phy3 (mdio:04). Pointing
	 * phy-handle at phy3 makes port 0 negotiate a link with the wrong PHY -
	 * the link comes up at 1 Gbps and the bridge puts the port in forwarding,
	 * but rx_packets stays at 0 because the data path never connects.
	 * Reversing only realtek,lan-phys is worse still: port 0 keeps phy-handle
	 * (phy0) and port 3 also gets phy0, so phy_attach_direct() fails with
	 * -EEXIST and LAN4 never registers.
	 *
	 * The panel order is therefore fixed by hardware: Linux lan1 is the jack
	 * silkscreened LAN4. Renaming the interfaces would need a driver change,
	 * not a device-tree change. */
	realtek,lan-phys = <&phy0 &phy1 &phy2 &phy3>;
	interrupts = <GIC_SPI 84 IRQ_TYPE_LEVEL_HIGH>;
};

&{/soc} {
	gpio0: gpio@4f43292c0 {
		compatible = "realtek,rtl9617c-gpio";
		reg = <4 0xf43292c0 0 0xb4>;
		gpio-controller;
		#gpio-cells = <2>;
		gpio-ranges = <&pinctrl 0 0 160>;
	};
};
